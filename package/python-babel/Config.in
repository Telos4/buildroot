## package/python-babel/Config.in
```kconfig
config BR2_PACKAGE_PYTHON_BABEL
	bool "python-babel"
	select BR2_PACKAGE_PYTHON_PYTZ # runtime
	help
	  Internationalization utilities.

	  https://babel.pocoo.org/
```

## package/python-blinker/Config.in
```kconfig
config BR2_PACKAGE_PYTHON_BLINKER
	bool "python-blinker"
        depends on BR2_PACKAGE_PYTHON3
	help
	  Blinker provides fast & simple object-to-object 
          and broadcast signaling for Python objects.

	  https://github.com/jek/blinker
```

## package/python-dnspython/Config.in
```kconfig
config BR2_PACKAGE_PYTHON_DNSPYTHON
	bool "python-dnspython"
	help
	  DNS toolkit.

	  http://www.dnspython.org
```

## package/python-email-validator/Config.in
```kconfig
config BR2_PACKAGE_PYTHON_EMAIL_VALIDATOR
	bool "python-email-validator"
	select BR2_PACKAGE_PYTHON_DNSPYTHON # runtime
	select BR2_PACKAGE_PYTHON_IDNA # runtime
	help
	  A robust email syntax and deliverability validation library
	  for Python 2.x/3.x.

	  https://github.com/JoshData/python-email-validator
```

## package/python-flask-login/Config.in
```kconfig
config BR2_PACKAGE_PYTHON_FLASK_LOGIN
	bool "python-flask-login"
	select BR2_PACKAGE_PYTHON_FLASK # runtime
	help
	  User session management for Flask.

	  https://github.com/maxcountryman/flask-login
```

## package/python-flask-mail/Config.in
```kconfig
config BR2_PACKAGE_PYTHON_FLASK_MAIL
	bool "python-flask-mail"
	# runtime dependency
	select BR2_PACKAGE_PYTHON_FLASK
	select BR2_PACKAGE_PYTHON_BLINKER
	help
	  A Flask extension for sending email messages.

	  https://github.com/mattupstate/flask-mail
```

## package/python-flask-principal/Config.in
```kconfig
config BR2_PACKAGE_PYTHON_FLASK_PRINCIPAL
	bool "python-flask-principal"
	select BR2_PACKAGE_PYTHON_BLINKER # runtime
	select BR2_PACKAGE_PYTHON_FLASK # runtime
	help
	  Identity management for flask.

	  http://packages.python.org/Flask-Principal/
```

## package/python-flask-security-too/Config.in
```kconfig
config BR2_PACKAGE_PYTHON_FLASK_SECURITY_TOO
	bool "python-flask-security-too"
	select BR2_PACKAGE_PYTHON_EMAIL_VALIDATOR # runtime
	select BR2_PACKAGE_PYTHON_FLASK # runtime
	select BR2_PACKAGE_PYTHON_FLASK_LOGIN # runtime
	select BR2_PACKAGE_PYTHON_FLASK_PRINCIPAL # runtime
	select BR2_PACKAGE_PYTHON_FLASK_WTF # runtime
	select BR2_PACKAGE_PYTHON_ITSDANGEROUS # runtime
	select BR2_PACKAGE_PYTHON_PASSLIB # runtime
	help
	  Simple security for Flask apps.

	  https://github.com/Flask-Middleware/flask-security
```

## package/python-flask-sqlalchemy/Config.in
```kconfig
config BR2_PACKAGE_PYTHON_FLASK_SQLALCHEMY
	bool "python-flask-sqlalchemy"
	select BR2_PACKAGE_PYTHON_FLASK # runtime
	select BR2_PACKAGE_PYTHON_SQLALCHEMY # runtime
	help
	  Adds SQLAlchemy support to your Flask application.

	  https://github.com/pallets/flask-sqlalchemy
```

## package/python-flask-wtf/Config.in
```kconfig
config BR2_PACKAGE_PYTHON_FLASK_WTF
	bool "python-flask-wtf"
	select BR2_PACKAGE_PYTHON_FLASK # runtime
	select BR2_PACKAGE_PYTHON_ITSDANGEROUS # runtime
	select BR2_PACKAGE_PYTHON_WTFORMS # runtime
	help
	  Form rendering, validation, and CSRF protection for Flask
	  with WTForms.

	  https://github.com/wtforms/flask-wtf/
```

## package/python-idna/Config.in
```kconfig
config BR2_PACKAGE_PYTHON_IDNA
	bool "python-idna"
	depends on BR2_PACKAGE_PYTHON3
	select BR2_PACKAGE_PYTHON3_UNICODEDATA
	help
	  Internationalized Domain Names in Applications (IDNA).

	  https://github.com/kjd/idna
```

## package/python-importlib-metadata_backup/Config.in
```kconfig
config BR2_PACKAGE_PYTHON_IMPORTLIB_METADATA
	bool "python-importlib-metadata"
	select BR2_PACKAGE_PYTHON_ZIPP # runtime
	help
	  Importlib metadata

	  https://github.com/python/importlib_metadata
```

## package/python-itsdangerous/Config.in
```kconfig
config BR2_PACKAGE_PYTHON_ITSDANGEROUS
        bool "python-itsdangerous"
        select BR2_PACKAGE_PYTHON_ZLIB if BR2_PACKAGE_PYTHON # runtime
        select BR2_PACKAGE_PYTHON3_ZLIB if BR2_PACKAGE_PYTHON3 # runtime

	help
	  Various helpers to pass data to untrusted environments and
	  back.

	  https://palletsprojects.com/p/itsdangerous/
```

## package/python-werkzeug/Config.in
```kconfig
config BR2_PACKAGE_PYTHON_WERKZEUG
	bool "python-werkzeug"
	select BR2_PACKAGE_PYTHON_MARKUPSAFE # runtime
	help
	  The comprehensive WSGI web application library.

	  https://palletsprojects.com/p/werkzeug/
```

## package/python-wtforms/Config.in
```kconfig
config BR2_PACKAGE_PYTHON_WTFORMS
	bool "python-wtforms"
	select BR2_PACKAGE_PYTHON_MARKUPSAFE # runtime
	help
	  Form validation and rendering for Python web development.

	  https://wtforms.readthedocs.io/
```
